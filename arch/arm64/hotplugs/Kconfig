## arch/arm64/hotplugs/Kconfig
```kconfig
config THUNDERPLUG_QUAD_CONTROL
 	bool "Enable plugging down/up of cores with/without using LCD NOTIFIER"
 	help
 	default y
	This driver doesn't uses LCD NOTIFIER to take down the cpu cores on a device Instead uses simple calculations which are tuned to sit perfectly on a quad core device :).
```
